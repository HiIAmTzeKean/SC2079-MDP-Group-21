/* USER CODE BEGIN Header */
/**
  ******************************************************************************
  * @file           : main.c
  * @brief          : Main program body
  ******************************************************************************
  * @attention
  *
  * Copyright (c) 2024 STMicroelectronics.
  * All rights reserved.
  *
  * This software is licensed under terms that can be found in the LICENSE file
  * in the root directory of this software component.
  * If no LICENSE file comes with this software, it is provided AS-IS.
  *
  ******************************************************************************
  */
/* USER CODE END Header */
/* Includes ------------------------------------------------------------------*/
#include "main.h"

/* Private includes ----------------------------------------------------------*/
/* USER CODE BEGIN Includes */
#include <stdlib.h>
#include <math.h>
#include "commands.h"
#include "dist.h"
#include "angle.h"
#include "delay_us.h"
#include "oled.h"
#include "sensors.h"
#include "motor.h"
#include "servo.h"
/* USER CODE END Includes */

/* Private typedef -----------------------------------------------------------*/
/* USER CODE BEGIN PTD */

/* USER CODE END PTD */

/* Private define ------------------------------------------------------------*/
/* USER CODE BEGIN PD */
//8MHz / 16000 = 2.0ms frame.
#define MS_FRAME 2.0f
#define SERIAL_BUF_SIZE 20
#define SERIAL_RING_SIZE 1000
#define DIST_DIFF_DEFAULT 50
#define BRAKE_SPEED 20
#define TICKS_ES_MAX 10
#define PI 3.14159265359
#define DEG_TO_RAD 180 / PI
/* USER CODE END PD */

/* Private macro -------------------------------------------------------------*/
/* USER CODE BEGIN PM */

/* USER CODE END PM */

/* Private variables ---------------------------------------------------------*/
ADC_HandleTypeDef hadc1;
ADC_HandleTypeDef hadc2;

I2C_HandleTypeDef hi2c1;

TIM_HandleTypeDef htim1;
TIM_HandleTypeDef htim2;
TIM_HandleTypeDef htim3;
TIM_HandleTypeDef htim4;
TIM_HandleTypeDef htim6;
TIM_HandleTypeDef htim7;
TIM_HandleTypeDef htim8;

UART_HandleTypeDef huart3;

/* USER CODE BEGIN PV */
//sensors variables.
Sensors sensors;
MagCalParams magCalParams;

//serial buffers.
volatile uint16_t ring_i = 0, track_i = 0;
uint16_t buf_i = 0;

uint8_t buf_serial[SERIAL_BUF_SIZE];
uint8_t ring_serial[SERIAL_RING_SIZE];

//ultrasound pulse width measurement.
volatile uint8_t isRisingCaptured = 0;
volatile uint8_t usCaptureComplete = 0;
volatile uint16_t usWrap = 0;
volatile uint32_t counter;

//paced loop.
volatile uint8_t newTick = 0;
/* USER CODE END PV */

/* Private function prototypes -----------------------------------------------*/
void SystemClock_Config(void);
static void MX_GPIO_Init(void);
static void MX_USART3_UART_Init(void);
static void MX_I2C1_Init(void);
static void MX_TIM8_Init(void);
static void MX_TIM2_Init(void);
static void MX_TIM3_Init(void);
static void MX_TIM1_Init(void);
static void MX_TIM4_Init(void);
static void MX_ADC1_Init(void);
static void MX_TIM6_Init(void);
static void MX_TIM7_Init(void);
static void MX_ADC2_Init(void);
/* USER CODE BEGIN PFP */

/* USER CODE END PFP */

/* Private user code ---------------------------------------------------------*/
/* USER CODE BEGIN 0 */

//increment index in a ring.
static void serial_inc_ring(volatile uint16_t *i) {
	*i = (*i + 1) % SERIAL_RING_SIZE;
}

//serial in.
void HAL_UART_RxCpltCallback(UART_HandleTypeDef *huart) {
	serial_inc_ring(&ring_i);
	HAL_UART_Receive_IT(&huart3, &ring_serial[ring_i], 1);
}

/* --- Start: Timer Management --- */
void HAL_TIM_PeriodElapsedCallback(TIM_HandleTypeDef *htim) {
	if (htim == &htim4) {
		usWrap++;
	}

	else if (htim == &htim7) {
		newTick = 1;
	}
}
void HAL_TIM_IC_CaptureCallback(TIM_HandleTypeDef *htim) {
	if (htim != &htim4) return;

	if (!isRisingCaptured) {
		//rising edge
		usCaptureComplete = 0;

		usWrap = 0;
		__HAL_TIM_SET_COUNTER(htim, 0);

		isRisingCaptured = 1;
		__HAL_TIM_SET_CAPTUREPOLARITY(htim, US_IC_CHANNEL, TIM_INPUTCHANNELPOLARITY_FALLING);
	} else {
		//falling edge
		counter = HAL_TIM_ReadCapturedValue(htim, US_IC_CHANNEL);
		counter += usWrap * 65536;
		sensors_read_usDist((float) counter * 1e-6);

		isRisingCaptured = 0;
		__HAL_TIM_SET_CAPTUREPOLARITY(htim, US_IC_CHANNEL, TIM_INPUTCHANNELPOLARITY_RISING);

		usCaptureComplete = 1;
	}
}
/* --- End: Timer Management --- */

/* USER CODE END 0 */

/**
  * @brief  The application entry point.
  * @retval int
  */
int main(void)
{

  /* USER CODE BEGIN 1 */
  uint8_t clear[100] = {0};
  /* USER CODE END 1 */

  /* MCU Configuration--------------------------------------------------------*/

  /* Reset of all peripherals, Initializes the Flash interface and the Systick. */
  HAL_Init();

  /* USER CODE BEGIN Init */
  /* USER CODE END Init */

  /* Configure the system clock */
  SystemClock_Config();

  /* USER CODE BEGIN SysInit */

  /* USER CODE END SysInit */

  /* Initialize all configured peripherals */
  MX_GPIO_Init();
  MX_USART3_UART_Init();
  MX_I2C1_Init();
  MX_TIM8_Init();
  MX_TIM2_Init();
  MX_TIM3_Init();
  MX_TIM1_Init();
  MX_TIM4_Init();
  MX_ADC1_Init();
  MX_TIM6_Init();
  MX_TIM7_Init();
  MX_ADC2_Init();
  /* USER CODE BEGIN 2 */

  /* ----- Start: Initialize libraries ----- */
  OLED_Init();												//initialize OLED display.
  magcal_init(&hi2c1, &magCalParams);						//initialize magnetometer calibration.
  motion_sen_init(&hi2c1, &hadc1, &hadc2, &htim4, &sensors); 	//initialize motion sensors.
  motor_init(&htim8, &htim2, &htim3); 						//initialize motor PWM and encoders.
  servo_init(&htim1); 										//initialize servo PWM.
  delay_us_init(&htim6);											//initialize us timer.

  dist_track_init();												//initialize distance tracking.
  /* ----- End: Initialize libraries ----- */

  /* ----- Start: Car setup ----- */
//  magcal_calc_params();

  //reset car.
  servo_setAngle(0);
  motor_setDrive(0, 0);
  //magcal_calc_params(); //Magcal prep to fix bias

  OLED_ShowString(0, 0, "Press USER when ready...");
  OLED_Refresh_Gram();
  while (!user_is_pressed());	//wait for user to place car.
  HAL_Delay(1000);
  servo_setAngle(0);
  OLED_Clear();
  OLED_ShowString(0, 0, "Calibrating...");
  OLED_Refresh_Gram();

  sensors_set_bias(5000); 		// set initial bias. 625 was working for us
  //sensors_set_bias(500);
  //HAL_Delay(500);

  OLED_ShowString(0, 0, "Calibration done.");
  OLED_Refresh_Gram();

  /* ----- End: Car setup ----- */

  /* ----- Start: OS Parameters ----- */
  //ticking for longer timing requirements for ultrasound, and servo turning.
  uint8_t ticksElapsed = 0,
		  ticksUsElapsed = 0,
		  ticksUs = (uint8_t) (US_MIN_DELAY / MS_FRAME) + 1,
		  ticksServo = (uint8_t) (SERVO_TURN_PERIOD / MS_FRAME),
		  ticksServoFull = (uint8_t) (SERVO_TURN_PERIOD * SERVO_WIDTH / SERVO_TURN_STEP) / MS_FRAME,
		  ticksMotor = (uint8_t) (MOTOR_CORRECTION_PERIOD / MS_FRAME),
		  ticksRefresh = lcm_uint8(lcm_uint8(ticksUs, ticksServo), ticksMotor),
		  ticksDelay = ticksServoFull - 1;

  //ticking for error stabilization.
  uint8_t ticksES = 0;

  Command *cmd = NULL;							//current command.
  float angleToSteer = 0;						//current steering angle.
  float motorDist = 0, estDist = 0, estAngle = 0, estDistOld = 0; 	//distance estimations.

  //for distance tracking (for use with INFO_DIST command).
  float distTrack = 0;
  volatile uint8_t shouldTrackDist = 0;			//This is the binary to check

  float distTarget = 0;							//decide distance target.
  float distDiff = 0, brakingDist = 0; 			//current distance difference.
  float distDiffOld = 0;						//track old distance difference (to see if stationary).
  float wDiff = 0, wTarget = 0;					//current angular velocity difference and target.
  float rBack = 0, rRobot = 0;					//turning radii at the back and centre of robot.

  uint32_t lastOLEDUpdate = 0;
  /* ----- End: OS Parameters ----- */

  /* ----- Start: Interrupts ----- */
  HAL_UART_Receive_IT(&huart3, &ring_serial[ring_i], 1);	//start receiving serial.
  HAL_TIM_Base_Start_IT(&htim7);							//start paced loop timer.
  /* ----- End: Interrupts ----- */

  OLED_Clear();
  OLED_ShowString(0, 0, "Active.");
  OLED_Refresh_Gram();

  char uart_msg[128];  // Buffer for UART message
  float gyro_bearing = 0;
  float gyroZ = 0;
  float last_time = 0;
  float GYRO_HPF_FREQ = 0.16;

  float gyro_drift_dps = 0;

  // 'frame_0_delay-0', 128x64px
  const uint8_t frame0[] = {  	0xd2, 0xff, 0xff, 0x8e, 0xe7, 0xff, 0x72, 0xb9, 0xfe, 0xe6, 0xef, 0x9f, 0xd5, 0xde, 0x98, 0x00,
  	0x7a, 0x3a, 0x83, 0xc1, 0xc3, 0x31, 0x3a, 0x47, 0xb3, 0xf1, 0xd3, 0xd0, 0xc0, 0x86, 0x40, 0xff,
  	0x7f, 0xa5, 0x20, 0x74, 0xbc, 0xe9, 0xed, 0xee, 0xe9, 0xac, 0xaf, 0xeb, 0xe7, 0x86, 0xeb, 0xe3,
  	0xd7, 0xf7, 0x37, 0x1a, 0xdf, 0xd8, 0xa1, 0x82, 0x67, 0x3f, 0xaf, 0x46, 0x08, 0xb5, 0x69, 0x8f,
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  	0x26, 0x28, 0xf9, 0xfd, 0x3a, 0x16, 0x3c, 0xbb, 0xfc, 0xec, 0xfc, 0x8f, 0x63, 0xcf, 0xd9, 0x15
  };
  // 'frame_1_delay-0', 128x64px
  const uint8_t frame1[] = {  	0x41, 0xfb, 0xfb, 0xc0, 0xf0, 0xdf, 0xbc, 0xbd, 0x31, 0xbc, 0xf8, 0x74, 0xe1, 0xc5, 0x91, 0x16,
  	0x24, 0x7e, 0x04, 0x11, 0xc3, 0xfc, 0xbc, 0x3f, 0x27, 0x77, 0x43, 0xd1, 0xe1, 0xcb, 0x43, 0x87,
  	0x2f, 0x78, 0x1f, 0xc3, 0x8f, 0x86, 0x86, 0x6a, 0x1e, 0x60, 0x30, 0xe8, 0xf8, 0xd2, 0xa1, 0x2f,
  	0x26, 0x38, 0x0d, 0xe5, 0xfd, 0xde, 0x70, 0xc0, 0x78, 0x78, 0xb8, 0xd7, 0xe0, 0x72, 0x0e, 0xb7,
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  	0x9c, 0x9b, 0xc0, 0x84, 0x86, 0xc6, 0x7a, 0x6e, 0xcc, 0x49, 0x89, 0xcd, 0xd3, 0xdf, 0xa1, 0xb7
  };
  // 'frame_2_delay-0', 128x64px
  const uint8_t frame2[] = {  	0x7f, 0xfb, 0xdf, 0xf4, 0xf7, 0xff, 0x8b, 0xea, 0xef, 0x8c, 0xb4, 0xbd, 0x9d, 0xc1, 0x60, 0x61,
  	0x18, 0x1e, 0x63, 0xd9, 0xf0, 0xe9, 0xe8, 0xe0, 0xc3, 0x30, 0xff, 0xbf, 0xd2, 0xb0, 0xba, 0xde,
  	0x74, 0x76, 0xf7, 0x74, 0xd6, 0x57, 0x75, 0x73, 0xc3, 0xf5, 0xf1, 0xe9, 0xeb, 0x9b, 0x8d, 0xef,
  	0xec, 0x50, 0x40, 0x33, 0x9d, 0xd7, 0x83, 0x24, 0xda, 0xb4, 0xe4, 0xd3, 0x87, 0x2a, 0x79, 0x63,
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  	0x38, 0x0e, 0x8e, 0xf9, 0xfc, 0xee, 0xed, 0x4f, 0xe0, 0xc9, 0x5b, 0x0e, 0x07, 0xcf, 0xca, 0x63
  };
  // 'frame_3_delay-0', 128x64px
  const uint8_t frame3[] = {  	0x50, 0xfb, 0xfb, 0x5e, 0xb5, 0xdf, 0x7c, 0xf8, 0x30, 0x40, 0x52, 0xde, 0x1a, 0xde, 0x5c, 0x3e,
  	0xb2, 0x70, 0xc0, 0x8b, 0x8b, 0x1b, 0x27, 0x80, 0x08, 0xf1, 0xfe, 0x4c, 0x3b, 0x1b, 0xb4, 0xe1,
  	0xc8, 0xf5, 0xc5, 0xe1, 0xc3, 0x37, 0xdd, 0x07, 0xeb, 0x87, 0xe3, 0xc5, 0x3d, 0x5f, 0x98, 0x5c,
  	0x74, 0x7d, 0x68, 0xd0, 0x97, 0x93, 0xce, 0x86, 0x70, 0x7f, 0x6e, 0x7a, 0x64, 0xbd, 0xfc, 0xce,
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  	0xef, 0xcf, 0x8f, 0xdf, 0x9f, 0xce, 0x1a, 0xc0, 0xc4, 0xd2, 0x66, 0x15, 0x7f, 0x6c, 0x6c, 0x41
  };
  // 'frame_4_delay-0', 128x64px
  const uint8_t frame4[] = {  	0xae, 0xff, 0xff, 0x01, 0xd1, 0xff, 0x36, 0x07, 0x82, 0x86, 0x72, 0x29, 0x2f, 0xe3, 0xe3, 0xa6,
  	0x80, 0x80, 0x01, 0xc1, 0xfe, 0xbf, 0x42, 0xe0, 0x49, 0xf9, 0xd2, 0xfb, 0xdc, 0x53, 0x59, 0x5f,
  	0xd7, 0x0e, 0x0e, 0xd7, 0xe7, 0xad, 0xef, 0x6d, 0x35, 0xb7, 0xb1, 0x43, 0x04, 0xcf, 0x5a, 0x4e,
  	0x8c, 0x10, 0x6a, 0xd2, 0x1f, 0x6e, 0x1d, 0xe5, 0xe1, 0xae, 0x79, 0xf1, 0xf5, 0x90, 0xe0, 0xbd,
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  	0xb5, 0x9f, 0x9f, 0x27, 0x6a, 0x38, 0x3d, 0x3d, 0x08, 0x8c, 0xe6, 0xac, 0x25, 0x67, 0x37, 0xe4
  };
  // 'frame_5_delay-0', 128x64px
  const uint8_t frame5[] = {  	0x8e, 0xf7, 0xf7, 0x06, 0x6f, 0xdf, 0x42, 0xed, 0x82, 0x7b, 0xd1, 0x31, 0xf2, 0xf3, 0xc1, 0x81,
  	0x49, 0x7e, 0x6b, 0x71, 0xf9, 0xf1, 0xe9, 0xc3, 0x8b, 0x27, 0x3c, 0x68, 0x9c, 0x03, 0xa3, 0xc5,
  	0xf9, 0x38, 0x6f, 0x6f, 0xff, 0x86, 0xa3, 0xc6, 0x96, 0x86, 0x0f, 0xde, 0x76, 0x1e, 0x87, 0x1f,
  	0x85, 0x1d, 0xf5, 0x3e, 0xc0, 0x70, 0xd1, 0xf4, 0xa4, 0x42, 0x5f, 0x4c, 0x78, 0x1a, 0xc3, 0xfb,
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  	0x9c, 0x8b, 0xa8, 0xc3, 0x38, 0x78, 0xbf, 0xbc, 0x3d, 0x7d, 0x7f, 0x3b, 0x78, 0x07, 0x42, 0x08
  };


  const uint8_t *gif_frames[] = {frame0, frame1, frame2, frame3, frame4, frame5};

  const char *text1 = "You built me but more than that, you cared for me";
  // Type text1 starting at (0,0) with a 100ms delay between characters
  OLED_TypeText(0, 0, text1, 100);

  while (1) {
      for (int i = 0; i < 6; i++) {
          OLED_ShowFrame(gif_frames[i]);
          HAL_Delay(100); // Frame delay
      }
  }

  /* USER CODE END 2 */

  /* Infinite loop */
  /* USER CODE BEGIN WHILE */
  while (1)
  {
    /* USER CODE END WHILE */

    /* USER CODE BEGIN 3 */
	/* ----- Start: Sensor reading ----- */
	//trigger distance measurement.

	if (!(ticksElapsed % ticksUs)) {
		motion_sen_us_trig();
	}

	//motion_sen_init
	motion_sen_read_accel();
	motion_sen_read_gyroZ();
	motion_sen_read_irDist();

	//sprintf(clear, "L:%09.6f     R:%09.6f     US:%09.6f\0", sensors.irDist[0],sensors.irDist[1],sensors.usDist);
	//OLED_ShowString(0, 10, clear);
	//OLED_Refresh_Gram();

	/* ----- End: Sensor reading ----- */

	/* ----- Start: Get next command (if any) ----- */ //Set the Command to drive
	if (cmd == NULL) {
//		sprintf(hello,"D: %d\0", distTrack);
//		OLED_ShowString(10, 20, hello);
//		OLED_Refresh_Gram();
		Command *peek = commands_peek();
//		Command *peek;
		if (!ticksDelay || (peek != NULL && peek->opType != DRIVE)) {
			cmd = commands_pop();

			if (cmd != NULL) {
				//perform command setup based on
				switch (cmd->opType) {
					case DRIVE:
						estDistOld = 0;
						estAngle = 0;
						motor_setDrive(cmd->dir, cmd->speed);
						if (cmd->dir != 0) {
							distTarget = cmd->val;
							distDiff = DIST_DIFF_DEFAULT;
							brakingDist = (cmd->distType == TARGET
								? MOTOR_BRAKING_DIST_CM_TARGET
								: MOTOR_BRAKING_DIST_CM_AWAY
							) * cmd->speed / 100;


							angleToSteer = cmd->angleToSteer;
							servo_setAngle(angleToSteer);
							if (angleToSteer != 0) {
								rBack = get_turning_r_back_cm(angleToSteer);
								//rBack = get_turning_r_steer_cm(angleToSteer);
								rRobot = get_turning_r_robot_cm(angleToSteer);
								if (cmd->distType == TARGET) {
									distTarget = abs_float(get_arc_length(cmd->val, rBack));
								}
							} else {
								rBack = 0;
								rRobot = 0;
								wTarget = 0;
							}


							//if (angleToSteer == 35) motor_freewheel(1);  // Freewheel right motor
							//else if (angleToSteer == -35) motor_freewheel(-1);  // Freewheel left motor
							//else motor_setDrive(cmd->dir, cmd->speed);

						} else {
							commands_end(&huart3, cmd);
							cmd = NULL;
						}
						break;

					case INFO_DIST:
					    shouldTrackDist = !shouldTrackDist;
					    if (shouldTrackDist) {
					        distTrack = 0;
					    } else {
					        free(cmd->str);
					        // Format response according to protocol: "Dxx.xx\n"
					        cmd->str_size = 8;  // "Dxx.xx\n" + null terminator
					        cmd->str = malloc(cmd->str_size);
					        snprintf(cmd->str, cmd->str_size, "D%6.2f\n", distTrack);

					        // Send via standard command completion
					        shouldTrackDist = 0;
					        distTrack = 0;
					    }
					    commands_end(&huart3, cmd);
					    cmd = NULL;
					    break;
					case INFO_MARKER:
						commands_end(&huart3, cmd);
						cmd = NULL;
						break;
					case TURN_IN_PLACE: {
					    // Set motors to turn in place
					    motor_setDifferential(1, cmd->speed, -1, cmd->speed);
						angleToSteer = cmd->angleToSteer;
						servo_setAngle(angleToSteer);
					    // Reset angle tracking
					    estAngle = 0;
					    float target_angle = cmd->val;  // From command

					    // Track angle using gyro
					    while (fabs(estAngle) < fabs(target_angle)) {
					        float wGyro = sensors.gyroZ;  // Get angular velocity
					        estAngle += wGyro * MS_FRAME; // Integrate over time
					        HAL_Delay(MS_FRAME);
					    }

					    // Stop after completing turn
					    motor_setDrive(0, 0);
					    commands_end(&huart3, cmd);
					    cmd = NULL;
					    break;
					}
				}
			}
		} else {
			peek = commands_peek_next_drive();
			if (peek != NULL) {
				servo_setAngle(peek->angleToSteer);
				if (ticksDelay > 0) ticksDelay--;
			}
		}
	}

	/* ----- End: Get next command (if any) ----- */

	/* ----- Start: Command Control Loop ----- */ //When running the commands
	if (cmd != NULL && cmd->dir != 0) {
		//calculate distance.
		motorDist = motor_getDist();
		estDist = cmd->dir * dist_get_cm(MS_FRAME, sensors.accel[1], motorDist);

		//estimate current speed.
		float estSpeed = (estDist - estDistOld) / MS_FRAME;
		estDistOld = estDist;

		//calculate difference in angular velocity.
		float wGyro;
		wGyro = cmd->dir * sensors.gyroZ;

		if (rBack != 0) {
			wTarget = get_w_ms(estSpeed, rBack);
		}
		else wTarget = 0;
		wDiff = (wGyro - wTarget); //gyro is flipped when going backwards.

		if (cmd->angleToSteer != 0) wDiff = 0;

		float angleDiff = wGyro * MS_FRAME;
		//if(!((angleDiff < GYRO_HPF_FREQ + 0.03) && (angleDiff > GYRO_HPF_FREQ - 0.03)));
		//else angleDiff = 0;
		if (cmd->angleToSteer < 0) angleDiff = -angleDiff;
		estAngle += angleDiff;
		distDiffOld = distDiff;

		uint8_t shouldEndIR = 0;

		switch (cmd->distType) {
			case TARGET:
				if (rBack != 0) {
					distDiff = get_arc_length(cmd->val - estAngle, abs_float(rBack));
				} else {
					distDiff = distTarget - estDist;
				}
				break;
			case STOP_AWAY:
				if (usCaptureComplete) { //This is glitchy I should change this soon
					distDiff = (sensors.usDist - cmd->val) * cmd->dir;
				}
				break;
			case STOP_L:
			case STOP_R:
			case STOP_L_LESS:
			case STOP_R_LESS:
				uint8_t i = (cmd->distType == STOP_L || cmd->distType == STOP_L_LESS) ? 0 : 1;
				float irVal = sensors.irDist[i];
				float cmdVal = cmd->val;
				if (cmdVal < 0) cmdVal = -cmdVal;

				if(cmd->distType == STOP_L || cmd->distType == STOP_R)
					shouldEndIR = irVal > cmdVal ? 1 : 0;
				else
					shouldEndIR = irVal < cmdVal ? 1 : 0;
				distDiff = DIST_DIFF_DEFAULT;
				break;
			default:
				distDiff = DIST_DIFF_DEFAULT;
				break;
		}

		Command *next = commands_peek();
		if (next != NULL && next->opType == DRIVE && commands_type_match(cmd, next)) {
			//absorb next command into current command.
			next = commands_pop();

			switch (next->distType) {
				case TARGET:
					cmd->val += next->val;
					break;
				case STOP_AWAY:
				case STOP_L:
				case STOP_R:
				case STOP_L_LESS:
				case STOP_R_LESS:
					cmd->val = next->val;
					break;
			}

			commands_end(&huart3, next);
		}

		next = commands_peek_next_drive();
		float queueAngle = next != NULL ? next->angleToSteer : 0;
		float queueAngleDiff = abs_float(queueAngle - cmd->angleToSteer);
		uint8_t shouldBrake = cmd->distType == STOP_AWAY ? 1 : next != NULL ? next->dir != cmd->dir
					|| queueAngleDiff > SERVO_WIDTH			//too large a turn.
					|| queueAngle * cmd->angleToSteer < 0	//opposite direction.
				: 1;
		uint8_t turnSpeed = next != NULL ? min_uint8(BRAKE_SPEED, next->speed) : BRAKE_SPEED;

		//motor correction.
		motor_pwmCorrection(
			wDiff, rBack, distDiff,
			brakingDist, cmd->distType,
			shouldBrake ? 0 : turnSpeed
		);
		//if (cmd->angleToSteer == 35) motor_freewheel(1);  // Freewheel right motor
		//else if (cmd->angleToSteer == -35) motor_freewheel(-1);  // Freewheel left motor

		float timeLeft = estSpeed > 0 ? distDiff / estSpeed : 1e10;

		uint8_t shouldEnd = 0;
		if (!shouldBrake && !(ticksElapsed % ticksServo)) {
			//turn a small angle every SERVO_TURN_PERIOD ms.
			float diff = abs_float(queueAngle - angleToSteer);

			if (timeLeft < (SERVO_TURN_PERIOD) * (diff / SERVO_TURN_STEP)) {
				//should increment.
				float step = min_float(SERVO_TURN_STEP, diff);
				if (queueAngle < angleToSteer) step = -step;
				angleToSteer += step;
				servo_setAngle(angleToSteer);

				if (diff < SERVO_TURN_STEP) {
					shouldEnd = 1;
				}
			}
		}

		float absDistDiff = abs_float(distDiff),
				absDistDiffChange = abs_float(distDiff - distDiffOld);
		uint8_t shouldTick = (shouldBrake
				&& absDistDiff < 1 && absDistDiffChange < 0.2)	//no change in motion.
				|| absDistDiff < 0.05;								//error threshold satisfied.
		ticksES = shouldTick ? ticksES + 1 : 0;

		shouldEnd |= ticksES >= TICKS_ES_MAX	//minimum error threshold ticks met.
					|| distDiff < 0.9; 		//prevent overshoot.
		shouldEnd |= shouldEndIR;
		if (shouldEnd) {
			//target achieved; move to next command.
			ticksES = 0;
			commands_end(&huart3, cmd);
			cmd = NULL;

			servo_setAngle(queueAngle);
			if (shouldBrake) {
				ticksDelay = (SERVO_TURN_PERIOD / MS_FRAME) * (abs_float(queueAngle - angleToSteer) / SERVO_TURN_STEP) + 15;
				motor_setDrive(0, 0);
				dist_reset(0);
			} else dist_reset(estSpeed);

			//add estimated travel distance to tracking distance (if tracked).
			if (shouldTrackDist) distTrack += estDist;
		}
	}
	/* ----- End: Command Control Loop ----- */
	/* ----- Start: Paced Loop Control ----- */
	while (!newTick) {									//wait for new tick.
		/* ----- Start: Process Ring Buffer ----- */
		/* We use the down time for paced looping to process commands. */
		if (track_i != ring_i) {
			uint8_t c = ring_serial[track_i];
			buf_serial[buf_i++] = c;
			if (c == CMD_END) {
				commands_process(&huart3, buf_serial, buf_i);
				buf_i = 0;
			}

			serial_inc_ring(&track_i);
		}
		/* ----- End: Process Ring Buffer ----- */
	}
	newTick = 0;										//acknowledge flag.

	ticksElapsed = (ticksElapsed + 1) % ticksRefresh;	//refresh tick count.
	/* ----- End: Paced Loop Control ----- */
  }
  /* USER CODE END 3 */
}

/**
  * @brief System Clock Configuration
  * @retval None
  */
void SystemClock_Config(void)
{
  RCC_OscInitTypeDef RCC_OscInitStruct = {0};
  RCC_ClkInitTypeDef RCC_ClkInitStruct = {0};

  /** Configure the main internal regulator output voltage
  */
  __HAL_RCC_PWR_CLK_ENABLE();
  __HAL_PWR_VOLTAGESCALING_CONFIG(PWR_REGULATOR_VOLTAGE_SCALE1);

  /** Initializes the RCC Oscillators according to the specified parameters
  * in the RCC_OscInitTypeDef structure.
  */
  RCC_OscInitStruct.OscillatorType = RCC_OSCILLATORTYPE_HSI;
  RCC_OscInitStruct.HSIState = RCC_HSI_ON;
  RCC_OscInitStruct.HSICalibrationValue = RCC_HSICALIBRATION_DEFAULT;
  RCC_OscInitStruct.PLL.PLLState = RCC_PLL_NONE;
  if (HAL_RCC_OscConfig(&RCC_OscInitStruct) != HAL_OK)
  {
    Error_Handler();
  }

  /** Initializes the CPU, AHB and APB buses clocks
  */
  RCC_ClkInitStruct.ClockType = RCC_CLOCKTYPE_HCLK|RCC_CLOCKTYPE_SYSCLK
                              |RCC_CLOCKTYPE_PCLK1|RCC_CLOCKTYPE_PCLK2;
  RCC_ClkInitStruct.SYSCLKSource = RCC_SYSCLKSOURCE_HSI;
  RCC_ClkInitStruct.AHBCLKDivider = RCC_SYSCLK_DIV1;
  RCC_ClkInitStruct.APB1CLKDivider = RCC_HCLK_DIV1;
  RCC_ClkInitStruct.APB2CLKDivider = RCC_HCLK_DIV1;

  if (HAL_RCC_ClockConfig(&RCC_ClkInitStruct, FLASH_LATENCY_0) != HAL_OK)
  {
    Error_Handler();
  }
}

/**
  * @brief ADC1 Initialization Function
  * @param None
  * @retval None
  */
static void MX_ADC1_Init(void)
{

  /* USER CODE BEGIN ADC1_Init 0 */

  /* USER CODE END ADC1_Init 0 */

  ADC_ChannelConfTypeDef sConfig = {0};

  /* USER CODE BEGIN ADC1_Init 1 */

  /* USER CODE END ADC1_Init 1 */

  /** Configure the global features of the ADC (Clock, Resolution, Data Alignment and number of conversion)
  */
  hadc1.Instance = ADC1;
  hadc1.Init.ClockPrescaler = ADC_CLOCK_SYNC_PCLK_DIV2;
  hadc1.Init.Resolution = ADC_RESOLUTION_12B;
  hadc1.Init.ScanConvMode = DISABLE;
  hadc1.Init.ContinuousConvMode = DISABLE;
  hadc1.Init.DiscontinuousConvMode = DISABLE;
  hadc1.Init.ExternalTrigConvEdge = ADC_EXTERNALTRIGCONVEDGE_NONE;
  hadc1.Init.ExternalTrigConv = ADC_SOFTWARE_START;
  hadc1.Init.DataAlign = ADC_DATAALIGN_RIGHT;
  hadc1.Init.NbrOfConversion = 1;
  hadc1.Init.DMAContinuousRequests = DISABLE;
  hadc1.Init.EOCSelection = ADC_EOC_SINGLE_CONV;
  if (HAL_ADC_Init(&hadc1) != HAL_OK)
  {
    Error_Handler();
  }

  /** Configure for the selected ADC regular channel its corresponding rank in the sequencer and its sample time.
  */
  sConfig.Channel = ADC_CHANNEL_11;
  sConfig.Rank = 1;
  sConfig.SamplingTime = ADC_SAMPLETIME_3CYCLES;
  if (HAL_ADC_ConfigChannel(&hadc1, &sConfig) != HAL_OK)
  {
    Error_Handler();
  }
  /* USER CODE BEGIN ADC1_Init 2 */

  /* USER CODE END ADC1_Init 2 */

}

/**
  * @brief ADC2 Initialization Function
  * @param None
  * @retval None
  */
static void MX_ADC2_Init(void)
{

  /* USER CODE BEGIN ADC2_Init 0 */

  /* USER CODE END ADC2_Init 0 */

  ADC_ChannelConfTypeDef sConfig = {0};

  /* USER CODE BEGIN ADC2_Init 1 */

  /* USER CODE END ADC2_Init 1 */

  /** Configure the global features of the ADC (Clock, Resolution, Data Alignment and number of conversion)
  */
  hadc2.Instance = ADC2;
  hadc2.Init.ClockPrescaler = ADC_CLOCK_SYNC_PCLK_DIV2;
  hadc2.Init.Resolution = ADC_RESOLUTION_12B;
  hadc2.Init.ScanConvMode = DISABLE;
  hadc2.Init.ContinuousConvMode = DISABLE;
  hadc2.Init.DiscontinuousConvMode = DISABLE;
  hadc2.Init.ExternalTrigConvEdge = ADC_EXTERNALTRIGCONVEDGE_NONE;
  hadc2.Init.ExternalTrigConv = ADC_SOFTWARE_START;
  hadc2.Init.DataAlign = ADC_DATAALIGN_RIGHT;
  hadc2.Init.NbrOfConversion = 1;
  hadc2.Init.DMAContinuousRequests = DISABLE;
  hadc2.Init.EOCSelection = ADC_EOC_SINGLE_CONV;
  if (HAL_ADC_Init(&hadc2) != HAL_OK)
  {
    Error_Handler();
  }

  /** Configure for the selected ADC regular channel its corresponding rank in the sequencer and its sample time.
  */
  sConfig.Channel = ADC_CHANNEL_12;
  sConfig.Rank = 1;
  sConfig.SamplingTime = ADC_SAMPLETIME_3CYCLES;
  if (HAL_ADC_ConfigChannel(&hadc2, &sConfig) != HAL_OK)
  {
    Error_Handler();
  }
  /* USER CODE BEGIN ADC2_Init 2 */

  /* USER CODE END ADC2_Init 2 */

}

/**
  * @brief I2C1 Initialization Function
  * @param None
  * @retval None
  */
static void MX_I2C1_Init(void)
{

  /* USER CODE BEGIN I2C1_Init 0 */

  /* USER CODE END I2C1_Init 0 */

  /* USER CODE BEGIN I2C1_Init 1 */

  /* USER CODE END I2C1_Init 1 */
  hi2c1.Instance = I2C1;
  hi2c1.Init.ClockSpeed = 400000;
  hi2c1.Init.DutyCycle = I2C_DUTYCYCLE_2;
  hi2c1.Init.OwnAddress1 = 0;
  hi2c1.Init.AddressingMode = I2C_ADDRESSINGMODE_7BIT;
  hi2c1.Init.DualAddressMode = I2C_DUALADDRESS_DISABLE;
  hi2c1.Init.OwnAddress2 = 0;
  hi2c1.Init.GeneralCallMode = I2C_GENERALCALL_DISABLE;
  hi2c1.Init.NoStretchMode = I2C_NOSTRETCH_DISABLE;
  if (HAL_I2C_Init(&hi2c1) != HAL_OK)
  {
    Error_Handler();
  }
  /* USER CODE BEGIN I2C1_Init 2 */

  /* USER CODE END I2C1_Init 2 */

}

/**
  * @brief TIM1 Initialization Function
  * @param None
  * @retval None
  */
static void MX_TIM1_Init(void)
{

  /* USER CODE BEGIN TIM1_Init 0 */

  /* USER CODE END TIM1_Init 0 */

  TIM_ClockConfigTypeDef sClockSourceConfig = {0};
  TIM_MasterConfigTypeDef sMasterConfig = {0};
  TIM_OC_InitTypeDef sConfigOC = {0};
  TIM_BreakDeadTimeConfigTypeDef sBreakDeadTimeConfig = {0};

  /* USER CODE BEGIN TIM1_Init 1 */

  /* USER CODE END TIM1_Init 1 */
  htim1.Instance = TIM1;
  htim1.Init.Prescaler = 5-1;
  htim1.Init.CounterMode = TIM_COUNTERMODE_UP;
  htim1.Init.Period = 64000-1;
  htim1.Init.ClockDivision = TIM_CLOCKDIVISION_DIV1;
  htim1.Init.RepetitionCounter = 0;
  htim1.Init.AutoReloadPreload = TIM_AUTORELOAD_PRELOAD_DISABLE;
  if (HAL_TIM_Base_Init(&htim1) != HAL_OK)
  {
    Error_Handler();
  }
  sClockSourceConfig.ClockSource = TIM_CLOCKSOURCE_INTERNAL;
  if (HAL_TIM_ConfigClockSource(&htim1, &sClockSourceConfig) != HAL_OK)
  {
    Error_Handler();
  }
  if (HAL_TIM_PWM_Init(&htim1) != HAL_OK)
  {
    Error_Handler();
  }
  sMasterConfig.MasterOutputTrigger = TIM_TRGO_RESET;
  sMasterConfig.MasterSlaveMode = TIM_MASTERSLAVEMODE_DISABLE;
  if (HAL_TIMEx_MasterConfigSynchronization(&htim1, &sMasterConfig) != HAL_OK)
  {
    Error_Handler();
  }
  sConfigOC.OCMode = TIM_OCMODE_PWM1;
  sConfigOC.Pulse = 0;
  sConfigOC.OCPolarity = TIM_OCPOLARITY_HIGH;
  sConfigOC.OCNPolarity = TIM_OCNPOLARITY_HIGH;
  sConfigOC.OCFastMode = TIM_OCFAST_DISABLE;
  sConfigOC.OCIdleState = TIM_OCIDLESTATE_RESET;
  sConfigOC.OCNIdleState = TIM_OCNIDLESTATE_RESET;
  if (HAL_TIM_PWM_ConfigChannel(&htim1, &sConfigOC, TIM_CHANNEL_1) != HAL_OK)
  {
    Error_Handler();
  }
  sBreakDeadTimeConfig.OffStateRunMode = TIM_OSSR_DISABLE;
  sBreakDeadTimeConfig.OffStateIDLEMode = TIM_OSSI_DISABLE;
  sBreakDeadTimeConfig.LockLevel = TIM_LOCKLEVEL_OFF;
  sBreakDeadTimeConfig.DeadTime = 0;
  sBreakDeadTimeConfig.BreakState = TIM_BREAK_DISABLE;
  sBreakDeadTimeConfig.BreakPolarity = TIM_BREAKPOLARITY_HIGH;
  sBreakDeadTimeConfig.AutomaticOutput = TIM_AUTOMATICOUTPUT_DISABLE;
  if (HAL_TIMEx_ConfigBreakDeadTime(&htim1, &sBreakDeadTimeConfig) != HAL_OK)
  {
    Error_Handler();
  }
  /* USER CODE BEGIN TIM1_Init 2 */

  /* USER CODE END TIM1_Init 2 */
  HAL_TIM_MspPostInit(&htim1);

}

/**
  * @brief TIM2 Initialization Function
  * @param None
  * @retval None
  */
static void MX_TIM2_Init(void)
{

  /* USER CODE BEGIN TIM2_Init 0 */

  /* USER CODE END TIM2_Init 0 */

  TIM_Encoder_InitTypeDef sConfig = {0};
  TIM_MasterConfigTypeDef sMasterConfig = {0};

  /* USER CODE BEGIN TIM2_Init 1 */

  /* USER CODE END TIM2_Init 1 */
  htim2.Instance = TIM2;
  htim2.Init.Prescaler = 0;
  htim2.Init.CounterMode = TIM_COUNTERMODE_UP;
  htim2.Init.Period = 65535;
  htim2.Init.ClockDivision = TIM_CLOCKDIVISION_DIV1;
  htim2.Init.AutoReloadPreload = TIM_AUTORELOAD_PRELOAD_DISABLE;
  sConfig.EncoderMode = TIM_ENCODERMODE_TI12;
  sConfig.IC1Polarity = TIM_ICPOLARITY_RISING;
  sConfig.IC1Selection = TIM_ICSELECTION_DIRECTTI;
  sConfig.IC1Prescaler = TIM_ICPSC_DIV1;
  sConfig.IC1Filter = 0;
  sConfig.IC2Polarity = TIM_ICPOLARITY_RISING;
  sConfig.IC2Selection = TIM_ICSELECTION_DIRECTTI;
  sConfig.IC2Prescaler = TIM_ICPSC_DIV1;
  sConfig.IC2Filter = 0;
  if (HAL_TIM_Encoder_Init(&htim2, &sConfig) != HAL_OK)
  {
    Error_Handler();
  }
  sMasterConfig.MasterOutputTrigger = TIM_TRGO_RESET;
  sMasterConfig.MasterSlaveMode = TIM_MASTERSLAVEMODE_DISABLE;
  if (HAL_TIMEx_MasterConfigSynchronization(&htim2, &sMasterConfig) != HAL_OK)
  {
    Error_Handler();
  }
  /* USER CODE BEGIN TIM2_Init 2 */

  /* USER CODE END TIM2_Init 2 */

}

/**
  * @brief TIM3 Initialization Function
  * @param None
  * @retval None
  */
static void MX_TIM3_Init(void)
{

  /* USER CODE BEGIN TIM3_Init 0 */

  /* USER CODE END TIM3_Init 0 */

  TIM_Encoder_InitTypeDef sConfig = {0};
  TIM_MasterConfigTypeDef sMasterConfig = {0};

  /* USER CODE BEGIN TIM3_Init 1 */

  /* USER CODE END TIM3_Init 1 */
  htim3.Instance = TIM3;
  htim3.Init.Prescaler = 0;
  htim3.Init.CounterMode = TIM_COUNTERMODE_UP;
  htim3.Init.Period = 65535;
  htim3.Init.ClockDivision = TIM_CLOCKDIVISION_DIV1;
  htim3.Init.AutoReloadPreload = TIM_AUTORELOAD_PRELOAD_DISABLE;
  sConfig.EncoderMode = TIM_ENCODERMODE_TI12;
  sConfig.IC1Polarity = TIM_ICPOLARITY_RISING;
  sConfig.IC1Selection = TIM_ICSELECTION_DIRECTTI;
  sConfig.IC1Prescaler = TIM_ICPSC_DIV1;
  sConfig.IC1Filter = 0;
  sConfig.IC2Polarity = TIM_ICPOLARITY_RISING;
  sConfig.IC2Selection = TIM_ICSELECTION_DIRECTTI;
  sConfig.IC2Prescaler = TIM_ICPSC_DIV1;
  sConfig.IC2Filter = 0;
  if (HAL_TIM_Encoder_Init(&htim3, &sConfig) != HAL_OK)
  {
    Error_Handler();
  }
  sMasterConfig.MasterOutputTrigger = TIM_TRGO_RESET;
  sMasterConfig.MasterSlaveMode = TIM_MASTERSLAVEMODE_DISABLE;
  if (HAL_TIMEx_MasterConfigSynchronization(&htim3, &sMasterConfig) != HAL_OK)
  {
    Error_Handler();
  }
  /* USER CODE BEGIN TIM3_Init 2 */

  /* USER CODE END TIM3_Init 2 */

}

/**
  * @brief TIM4 Initialization Function
  * @param None
  * @retval None
  */
static void MX_TIM4_Init(void)
{

  /* USER CODE BEGIN TIM4_Init 0 */

  /* USER CODE END TIM4_Init 0 */

  TIM_ClockConfigTypeDef sClockSourceConfig = {0};
  TIM_MasterConfigTypeDef sMasterConfig = {0};
  TIM_IC_InitTypeDef sConfigIC = {0};

  /* USER CODE BEGIN TIM4_Init 1 */

  /* USER CODE END TIM4_Init 1 */
  htim4.Instance = TIM4;
  htim4.Init.Prescaler = 16-1;
  htim4.Init.CounterMode = TIM_COUNTERMODE_UP;
  htim4.Init.Period = 65536-1;
  htim4.Init.ClockDivision = TIM_CLOCKDIVISION_DIV1;
  htim4.Init.AutoReloadPreload = TIM_AUTORELOAD_PRELOAD_DISABLE;
  if (HAL_TIM_Base_Init(&htim4) != HAL_OK)
  {
    Error_Handler();
  }
  sClockSourceConfig.ClockSource = TIM_CLOCKSOURCE_INTERNAL;
  if (HAL_TIM_ConfigClockSource(&htim4, &sClockSourceConfig) != HAL_OK)
  {
    Error_Handler();
  }
  if (HAL_TIM_IC_Init(&htim4) != HAL_OK)
  {
    Error_Handler();
  }
  sMasterConfig.MasterOutputTrigger = TIM_TRGO_RESET;
  sMasterConfig.MasterSlaveMode = TIM_MASTERSLAVEMODE_DISABLE;
  if (HAL_TIMEx_MasterConfigSynchronization(&htim4, &sMasterConfig) != HAL_OK)
  {
    Error_Handler();
  }
  sConfigIC.ICPolarity = TIM_INPUTCHANNELPOLARITY_RISING;
  sConfigIC.ICSelection = TIM_ICSELECTION_DIRECTTI;
  sConfigIC.ICPrescaler = TIM_ICPSC_DIV1;
  sConfigIC.ICFilter = 0;
  if (HAL_TIM_IC_ConfigChannel(&htim4, &sConfigIC, TIM_CHANNEL_1) != HAL_OK)
  {
    Error_Handler();
  }
  /* USER CODE BEGIN TIM4_Init 2 */

  /* USER CODE END TIM4_Init 2 */

}

/**
  * @brief TIM6 Initialization Function
  * @param None
  * @retval None
  */
static void MX_TIM6_Init(void)
{

  /* USER CODE BEGIN TIM6_Init 0 */

  /* USER CODE END TIM6_Init 0 */

  TIM_MasterConfigTypeDef sMasterConfig = {0};

  /* USER CODE BEGIN TIM6_Init 1 */

  /* USER CODE END TIM6_Init 1 */
  htim6.Instance = TIM6;
  htim6.Init.Prescaler = 16-1;
  htim6.Init.CounterMode = TIM_COUNTERMODE_UP;
  htim6.Init.Period = 65536-1;
  htim6.Init.AutoReloadPreload = TIM_AUTORELOAD_PRELOAD_DISABLE;
  if (HAL_TIM_Base_Init(&htim6) != HAL_OK)
  {
    Error_Handler();
  }
  sMasterConfig.MasterOutputTrigger = TIM_TRGO_RESET;
  sMasterConfig.MasterSlaveMode = TIM_MASTERSLAVEMODE_DISABLE;
  if (HAL_TIMEx_MasterConfigSynchronization(&htim6, &sMasterConfig) != HAL_OK)
  {
    Error_Handler();
  }
  /* USER CODE BEGIN TIM6_Init 2 */

  /* USER CODE END TIM6_Init 2 */

}

/**
  * @brief TIM7 Initialization Function
  * @param None
  * @retval None
  */
static void MX_TIM7_Init(void)
{

  /* USER CODE BEGIN TIM7_Init 0 */

  /* USER CODE END TIM7_Init 0 */

  TIM_MasterConfigTypeDef sMasterConfig = {0};

  /* USER CODE BEGIN TIM7_Init 1 */

  /* USER CODE END TIM7_Init 1 */
  htim7.Instance = TIM7;
  htim7.Init.Prescaler = 2-1;
  htim7.Init.CounterMode = TIM_COUNTERMODE_UP;
  htim7.Init.Period = 16000-1;
  htim7.Init.AutoReloadPreload = TIM_AUTORELOAD_PRELOAD_DISABLE;
  if (HAL_TIM_Base_Init(&htim7) != HAL_OK)
  {
    Error_Handler();
  }
  sMasterConfig.MasterOutputTrigger = TIM_TRGO_RESET;
  sMasterConfig.MasterSlaveMode = TIM_MASTERSLAVEMODE_DISABLE;
  if (HAL_TIMEx_MasterConfigSynchronization(&htim7, &sMasterConfig) != HAL_OK)
  {
    Error_Handler();
  }
  /* USER CODE BEGIN TIM7_Init 2 */

  /* USER CODE END TIM7_Init 2 */

}

/**
  * @brief TIM8 Initialization Function
  * @param None
  * @retval None
  */
static void MX_TIM8_Init(void)
{

  /* USER CODE BEGIN TIM8_Init 0 */

  /* USER CODE END TIM8_Init 0 */

  TIM_ClockConfigTypeDef sClockSourceConfig = {0};
  TIM_MasterConfigTypeDef sMasterConfig = {0};
  TIM_OC_InitTypeDef sConfigOC = {0};
  TIM_BreakDeadTimeConfigTypeDef sBreakDeadTimeConfig = {0};

  /* USER CODE BEGIN TIM8_Init 1 */

  /* USER CODE END TIM8_Init 1 */
  htim8.Instance = TIM8;
  htim8.Init.Prescaler = 0;
  htim8.Init.CounterMode = TIM_COUNTERMODE_UP;
  htim8.Init.Period = 7200-1;
  htim8.Init.ClockDivision = TIM_CLOCKDIVISION_DIV1;
  htim8.Init.RepetitionCounter = 0;
  htim8.Init.AutoReloadPreload = TIM_AUTORELOAD_PRELOAD_DISABLE;
  if (HAL_TIM_Base_Init(&htim8) != HAL_OK)
  {
    Error_Handler();
  }
  sClockSourceConfig.ClockSource = TIM_CLOCKSOURCE_INTERNAL;
  if (HAL_TIM_ConfigClockSource(&htim8, &sClockSourceConfig) != HAL_OK)
  {
    Error_Handler();
  }
  if (HAL_TIM_PWM_Init(&htim8) != HAL_OK)
  {
    Error_Handler();
  }
  sMasterConfig.MasterOutputTrigger = TIM_TRGO_RESET;
  sMasterConfig.MasterSlaveMode = TIM_MASTERSLAVEMODE_DISABLE;
  if (HAL_TIMEx_MasterConfigSynchronization(&htim8, &sMasterConfig) != HAL_OK)
  {
    Error_Handler();
  }
  sConfigOC.OCMode = TIM_OCMODE_PWM1;
  sConfigOC.Pulse = 0;
  sConfigOC.OCPolarity = TIM_OCPOLARITY_HIGH;
  sConfigOC.OCNPolarity = TIM_OCNPOLARITY_HIGH;
  sConfigOC.OCFastMode = TIM_OCFAST_DISABLE;
  sConfigOC.OCIdleState = TIM_OCIDLESTATE_RESET;
  sConfigOC.OCNIdleState = TIM_OCNIDLESTATE_RESET;
  if (HAL_TIM_PWM_ConfigChannel(&htim8, &sConfigOC, TIM_CHANNEL_1) != HAL_OK)
  {
    Error_Handler();
  }
  if (HAL_TIM_PWM_ConfigChannel(&htim8, &sConfigOC, TIM_CHANNEL_2) != HAL_OK)
  {
    Error_Handler();
  }
  sBreakDeadTimeConfig.OffStateRunMode = TIM_OSSR_DISABLE;
  sBreakDeadTimeConfig.OffStateIDLEMode = TIM_OSSI_DISABLE;
  sBreakDeadTimeConfig.LockLevel = TIM_LOCKLEVEL_OFF;
  sBreakDeadTimeConfig.DeadTime = 0;
  sBreakDeadTimeConfig.BreakState = TIM_BREAK_DISABLE;
  sBreakDeadTimeConfig.BreakPolarity = TIM_BREAKPOLARITY_HIGH;
  sBreakDeadTimeConfig.AutomaticOutput = TIM_AUTOMATICOUTPUT_DISABLE;
  if (HAL_TIMEx_ConfigBreakDeadTime(&htim8, &sBreakDeadTimeConfig) != HAL_OK)
  {
    Error_Handler();
  }
  /* USER CODE BEGIN TIM8_Init 2 */

  /* USER CODE END TIM8_Init 2 */
  HAL_TIM_MspPostInit(&htim8);

}

/**
  * @brief USART3 Initialization Function
  * @param None
  * @retval None
  */
static void MX_USART3_UART_Init(void)
{

  /* USER CODE BEGIN USART3_Init 0 */

  /* USER CODE END USART3_Init 0 */

  /* USER CODE BEGIN USART3_Init 1 */

  /* USER CODE END USART3_Init 1 */
  huart3.Instance = USART3;
  huart3.Init.BaudRate = 115200;
  huart3.Init.WordLength = UART_WORDLENGTH_8B;
  huart3.Init.StopBits = UART_STOPBITS_1;
  huart3.Init.Parity = UART_PARITY_NONE;
  huart3.Init.Mode = UART_MODE_TX_RX;
  huart3.Init.HwFlowCtl = UART_HWCONTROL_NONE;
  huart3.Init.OverSampling = UART_OVERSAMPLING_16;
  if (HAL_UART_Init(&huart3) != HAL_OK)
  {
    Error_Handler();
  }
  /* USER CODE BEGIN USART3_Init 2 */

  /* USER CODE END USART3_Init 2 */

}

/**
  * @brief GPIO Initialization Function
  * @param None
  * @retval None
  */
static void MX_GPIO_Init(void)
{
  GPIO_InitTypeDef GPIO_InitStruct = {0};
/* USER CODE BEGIN MX_GPIO_Init_1 */
/* USER CODE END MX_GPIO_Init_1 */

  /* GPIO Ports Clock Enable */
  __HAL_RCC_GPIOE_CLK_ENABLE();
  __HAL_RCC_GPIOC_CLK_ENABLE();
  __HAL_RCC_GPIOA_CLK_ENABLE();
  __HAL_RCC_GPIOD_CLK_ENABLE();
  __HAL_RCC_GPIOB_CLK_ENABLE();

  /*Configure GPIO pin Output Level */
  HAL_GPIO_WritePin(GPIOE, OLED_SCLK_Pin|OLED_SDIN_Pin|OLED_RESET__Pin|OLED_DATA_COMMAND__Pin, GPIO_PIN_RESET);

  /*Configure GPIO pin Output Level */
  HAL_GPIO_WritePin(GPIOA, MOTORA_IN2_Pin|MOTORA_IN1_Pin|MOTORB_IN1_Pin|MOTORB_IN2_Pin, GPIO_PIN_RESET);

  /*Configure GPIO pin Output Level */
  HAL_GPIO_WritePin(US_TRIG_GPIO_Port, US_TRIG_Pin, GPIO_PIN_RESET);

  /*Configure GPIO pins : OLED_SCLK_Pin OLED_SDIN_Pin OLED_RESET__Pin OLED_DATA_COMMAND__Pin */
  GPIO_InitStruct.Pin = OLED_SCLK_Pin|OLED_SDIN_Pin|OLED_RESET__Pin|OLED_DATA_COMMAND__Pin;
  GPIO_InitStruct.Mode = GPIO_MODE_OUTPUT_PP;
  GPIO_InitStruct.Pull = GPIO_NOPULL;
  GPIO_InitStruct.Speed = GPIO_SPEED_FREQ_LOW;
  HAL_GPIO_Init(GPIOE, &GPIO_InitStruct);

  /*Configure GPIO pins : MOTORA_IN2_Pin MOTORA_IN1_Pin MOTORB_IN1_Pin MOTORB_IN2_Pin */
  GPIO_InitStruct.Pin = MOTORA_IN2_Pin|MOTORA_IN1_Pin|MOTORB_IN1_Pin|MOTORB_IN2_Pin;
  GPIO_InitStruct.Mode = GPIO_MODE_OUTPUT_PP;
  GPIO_InitStruct.Pull = GPIO_NOPULL;
  GPIO_InitStruct.Speed = GPIO_SPEED_FREQ_LOW;
  HAL_GPIO_Init(GPIOA, &GPIO_InitStruct);

  /*Configure GPIO pin : BTN_USER_Pin */
  GPIO_InitStruct.Pin = BTN_USER_Pin;
  GPIO_InitStruct.Mode = GPIO_MODE_INPUT;
  GPIO_InitStruct.Pull = GPIO_PULLUP;
  HAL_GPIO_Init(BTN_USER_GPIO_Port, &GPIO_InitStruct);

  /*Configure GPIO pin : US_TRIG_Pin */
  GPIO_InitStruct.Pin = US_TRIG_Pin;
  GPIO_InitStruct.Mode = GPIO_MODE_OUTPUT_PP;
  GPIO_InitStruct.Pull = GPIO_NOPULL;
  GPIO_InitStruct.Speed = GPIO_SPEED_FREQ_LOW;
  HAL_GPIO_Init(US_TRIG_GPIO_Port, &GPIO_InitStruct);

/* USER CODE BEGIN MX_GPIO_Init_2 */
/* USER CODE END MX_GPIO_Init_2 */
}

/* USER CODE BEGIN 4 */

/* USER CODE END 4 */

/**
  * @brief  This function is executed in case of error occurrence.
  * @retval None
  */
void Error_Handler(void)
{
  /* USER CODE BEGIN Error_Handler_Debug */
  /* User can add his own implementation to report the HAL error return state */
  __disable_irq();
  while (1)
  {
  }
  /* USER CODE END Error_Handler_Debug */
}

#ifdef  USE_FULL_ASSERT
/**
  * @brief  Reports the name of the source file and the source line number
  *         where the assert_param error has occurred.
  * @param  file: pointer to the source file name
  * @param  line: assert_param error line source number
  * @retval None
  */
void assert_failed(uint8_t *file, uint32_t line)
{
  /* USER CODE BEGIN 6 */
  /* User can add his own implementation to report the file name and line number,
     ex: printf("Wrong parameters value: file %s on line %d\r\n", file, line) */
  /* USER CODE END 6 */
}
#endif /* USE_FULL_ASSERT */
